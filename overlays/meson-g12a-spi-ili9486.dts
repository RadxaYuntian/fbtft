// Based on https://github.com/goodtft/LCD-show/blob/master/usr/tft35a-overlay.dtb

/dts-v1/;
/plugin/;

/ {
    compatible = "radxa,zero", "amlogic,g12a";

    fragment@0 {
        target = <&spicc1>;
        __overlay__ {
            #address-cells = <1>;
            #size-cells = <0>;
            pinctrl-0 = <&spicc1_pins &spicc1_ss0_pins>;
            pinctrl-names = "default";

            ili9486: ili9486@0 {
                compatible = "ilitek,ili9486";
                status = "okay";
                reg = <0>;
                debug = <0>;

                spi-max-frequency = <16000000>;
                txbuflen = <0x8000>;
                rotate = <90>;
                fps = <30>;
                buswidth = <8>;
                regwidth = <16>;
                bgr = <0>;
                
                dc-gpios = <&gpio 73 0>; // Pin 18
                reset-gpios = <&gpio 48 1>; // Pin 22

                init = <0x10000f1 0x36 0x04 0x00 0x3c 0x0f 0x8f
                        0x10000f2 0x18 0xa3 0x12 0x02 0xb2 0x12 0xff 0x10 0x00
                        0x10000f8 0x21 0x04
                        0x10000f9 0x00 0x08
                        0x1000036 0x08
                        0x10000b4 0x00
                        0x10000c1 0x41
                        0x10000c5 0x00 0x91 0x80 0x00
                        0x10000e0 0x0f 0x1f 0x1c 0x0c 0x0f 0x08 0x48 0x98 0x37 0x0a 0x13 0x04 0x11 0x0d 0x00
                        0x10000e1 0x0f 0x32 0x2e 0x0b 0x0d 0x05 0x47 0x75 0x37 0x06 0x10 0x03 0x24 0x20 0x00
                        0x100003a 0x55
                        0x1000011
                        0x1000036 0x28
                        0x20000ff
                        0x1000029>;
            };
        };
    };
};